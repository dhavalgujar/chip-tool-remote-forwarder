## components/chip_tool_forwarder/Kconfig
```kconfig
# SPDX-License-Identifier: Apache-2.0

menu "chip-tool forwarder"

    config CHIP_TOOL_FORWARDER_MAX_CONNECTIONS
        int "chip-tool-remote connections at once"
        default 4
        range 1 8
        help
            Each costs about 25 KB of PSRAM: a TLS session with 4 KB record
            buffers, frame buffers and a 6 KB task stack (full 16 KB buffers
            during the handshake).

endmenu
```

## components/esp32_matter_gateway/Kconfig
```kconfig
# SPDX-License-Identifier: Apache-2.0

menu "Matter gateway"

    config ESP32_MATTER_GATEWAY_MAX_CONNECTIONS
        int "chip-tool-gw connections at once"
        default 4
        range 1 8
        help
            Each costs about 25 KB of PSRAM: a TLS session with 4 KB record
            buffers, frame buffers and a 6 KB task stack (full 16 KB buffers
            during the handshake).

endmenu
```

## examples/forwarder/main/Kconfig.projbuild
```kconfig
# SPDX-License-Identifier: Apache-2.0

menu "forwarder example"

    config EXAMPLE_WIFI_SSID
        string "Wi-Fi SSID"
        default ""
        help
            The network the forwarder joins. The Matter devices it commissions
            join it too, unless they're Thread devices.

    config EXAMPLE_WIFI_PASSWORD
        string "Wi-Fi password"
        default ""

endmenu
```

## examples/forwarder/sdkconfig.defaults.esp32s3
```kconfig
# SPDX-License-Identifier: Apache-2.0
# ESP32-S3-DevKitC-1 (N8R8): octal PSRAM
CONFIG_SPIRAM_MODE_OCT=y
CONFIG_SPIRAM_SPEED_80M=y
CONFIG_ESPTOOLPY_FLASHMODE_QIO=y
```

## examples/gateway/main/Kconfig.projbuild
```kconfig
# SPDX-License-Identifier: Apache-2.0

menu "Matter gateway example"

    config EXAMPLE_WIFI_SSID
        string "Wi-Fi SSID"
        default ""
        help
            The network the gateway joins. The Matter devices it commissions
            join it too, unless they're Thread devices.

    config EXAMPLE_WIFI_PASSWORD
        string "Wi-Fi password"
        default ""

endmenu
```

## examples/gateway/sdkconfig.defaults.esp32c5
```kconfig
# SPDX-License-Identifier: Apache-2.0
# ESP32-C5-DevKitC-1: quad PSRAM
CONFIG_SPIRAM_MODE_QUAD=y
CONFIG_SPIRAM_SPEED_80M=y
CONFIG_ESPTOOLPY_FLASHMODE_QIO=y
```
